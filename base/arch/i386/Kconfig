## fusion/arch/ia64/Kconfig
```kconfig
mainmenu "RTAI/ia64 configuration"

source Kconfig

source "nucleus/Kconfig"

menu "Machine (ia64)"

config RTAI_HW_APERIODIC_TIMER
	bool "Enable aperiodic timer support"
	default y
	help
	The nucleus can handle aperiodic timers that can be
	programmed in one-shot mode on this architecture. In this
	mode, timing accuracy is higher - since it is not rounded to a
	constant time slice - at the expense of a lesser efficicency
	when many timers are simultaneously active. The aperiodic mode
	gives better results in configuration involving a few threads
	requesting timing services over different time scales that
	cannot be easily expressed as multiples of a single base tick,
	or would lead to a waste of high frequency periodical
	ticks. You can disable this support for this architecture to
	save a few hundreds bytes if you plan to use the system timer
	in periodic mode only.

config RTAI_HW_TIMER_LATENCY
	depends on RTAI_OPT_EXPERT
	string "Timer tuning latency (ns)"
	default 0
	help
	This parameter accounts for the time (in nanoseconds) needed
	to program the underlying time source in one-shot timing mode.
	This value will be used to reduce the scheduling jitter induced
	by the time needed to setup the timer for its next shot. A
	default value of 0 (recommended) will cause this value to be
	estimated by the nucleus at startup.

config RTAI_HW_SCHED_LATENCY
	depends on RTAI_OPT_EXPERT
	string "Scheduling latency (ns)"
	default 0
	help
	Scheduling latency is the time between the termination of an
	interrupt handler and the execution of the first instruction
	of the real-time thread this handler resumes. A
	default value of 0 (recommended) will cause this value to be
	estimated by the nucleus at startup.

config RTAI_HW_STACK_POOL
        string "Number of pre-allocated kernel stacks"
        default 4
        help
	The current implementation for the Itanium architecture
	requires that stacks of RTAI/fusion threads running in kernel
	space be pre-allocated in a separate pool. This parameter
	allows to set the size of this stack spool, which consequently
	defines the maximum number of concurrently runnable
	kernel-based threads at any point in time. Nb: RTAI/fusion
	threads running in user-space are _not_ impacted by this
	limit.

endmenu

source "skins/Kconfig"

source "sim/Kconfig"
```

## fusion/arch/ppc/Kconfig
```kconfig
mainmenu "RTAI/powerpc configuration"

source Kconfig

menu "Machine (powerpc)"

config RTAI_HW_FPU
	bool "Enable FPU support"
	default y
	help
	The FPU executes instructions from the processor's normal
	instruction stream. It can handle the types of high-precision
	floating-point processing operations commonly found in
	scientific, engineering, and business applications.  Enabling
	FPU support on a platform providing this hardware component
	may greatly improve performances.

config RTAI_HW_TIMER_LATENCY
	depends on RTAI_OPT_EXPERT
	string "Timer tuning latency (ns)"
	default 0
	help
	This parameter accounts for the time (in nanoseconds) needed
	to program the underlying time source in one-shot timing mode.
	This value will be used to reduce the scheduling jitter induced
	by the time needed to setup the timer for its next shot. A
	default value of 0 (recommended) will cause this value to be
	estimated by the nucleus at startup.

config RTAI_HW_SCHED_LATENCY
	depends on RTAI_OPT_EXPERT
	string "Scheduling latency (ns)"
	default 0
	help
	Scheduling latency is the time between the termination of an
	interrupt handler and the execution of the first instruction
	of the real-time thread this handler resumes. A
	default value of 0 (recommended) will cause this value to be
	estimated by the nucleus at startup.

endmenu

source "skins/Kconfig"

source "sim/Kconfig"
```

## fusion/drivers/16550A/Kconfig
```kconfig
config RTAI_DRIVERS_16550A
	depends on RTAI_SKIN_RTDM
	bool "16550A UART driver"
	default n
	help
	Real-time UART driver for 16550A compatible controllers.
```

## fusion/nucleus/Kconfig
```kconfig
menu "Nucleus"

config RTAI_OPT_FUSION
	bool "Real-time support in user-space"
	default y
	help

	Enable all real-time features for user-space Linux
	processes, which is the default operating mode for
	RTAI/fusion. Switching this option out only leaves the
	minimal support needed for running in-kernel
	applications, which directly call the real-time APIs from
	kernel modules.

config RTAI_OPT_PIPE
	bool "Message pipes"
	default y
	help

	Message pipes are bi-directional FIFO communication
	channels allowing data exchange between real-time kernel
	threads and regular user-space processes. Pipes natively
	preserve message boundaries, but can also be used in byte
	streaming mode from kernel to user-space.

config RTAI_OPT_PIPE_NRDEV
	string "Number of pipe devices"
	depends on RTAI_OPT_PIPE
	default 32
	help
	
	This option sets the maximum number of pipe devices supported
	in the system. Pipe devices are named /dev/rtpN where N is a
	device minor number ranging from 0 to RTAI_OPT_PIPE_NRDEV - 1.

config RTAI_OPT_SYS_HEAPSZ
	string "Size of the system heap (Kb)"
	default 128
	help

	The system heap is used for various internal allocations by
	the nucleus and the real-time skins. The size is expressed in
	Kilobytes.

config RTAI_OPT_ISHIELD
	bool "Interrupt shield support"
	depends on RTAI_OPT_EXPERT && RTAI_OPT_FUSION
	default y
	help
	
	This option builds in the interrupt shield support, which can
	be further enabled on a thread-by-thread basis. When enabled
	for a thread, the interrupt shield prevents it from being
	preempted by Linux interrupt handlers when it executes in the
	secondary domain (i.e. under the control of the Linux
	scheduler), thus increasing the execution time accuracy for
	CPU-bound tasks. Note: this option has no additional effect on
	threads running in the primary RTAI domain, for which
	preemption by any kind of Linux kernel activities is already
	prevented by design.

config RTAI_OPT_STATS
	bool "Statistics collection"
	depends on RTAI_OPT_EXPERT
	default y
	help
	
	This option causes the real-time nucleus to collect various
	per-thread runtime statistics, which are accessible through
	the /proc/rtai/stats interface.

config RTAI_OPT_DEBUG
	bool "Debug support"
	depends on RTAI_OPT_EXPERT
	default n
	help
	
	This option activates various debugging checks inside the core
	system. Doing so adds a significant runtime overhead,
	worsening the latency figures especially on SMP kernels.
	Do not switch this option on unless you really know what you
	are doing.

config RTAI_OPT_WATCHDOG
	bool "Watchdog support"
	depends on RTAI_OPT_EXPERT
	default n
	help
	
	This option activates a watchdog aimed at detecting runaway
	real-time threads. If enabled, the watchdog triggers after 4
	seconds of uninterrupted real-time activity without Linux
	interaction; in such event, the current real-time thread is
	forcibly suspended. The built-in watchdog support operates on
	behalf of the timer tick handler, thus is only active after
	the timer has been started.

menu "Scalability"
	depends on RTAI_OPT_EXPERT

config RTAI_OPT_SCALABLE_SCHED
	bool "O(1) scheduler"
	default n
	help
	
	This option causes a multi-level priority queue to be
	used in the real-time thread scheduler, so that it operates
	in constant-time regardless of the number of _concurrently
	runnable_ threads (which might be much lower than the total
	number of active threads). Its use is recommended for
	large multi-threaded systems involving more than 10 of such
	threads; otherwise, the default linear method usually performs
	better with lower memory footprints.

config RTAI_OPT_SCALABLE_PRIOS
	string "Number of priority levels"
	depends on RTAI_OPT_SCALABLE_SCHED
	default 256
	help

	This option sets the maximum number of priority levels available
	within the scalable scheduler's multi-level queue. This value
	must be higher or equal than the maximum priority range which
	could be required for running the real-time skin used by the
	application. For instance, the native RTAI skin needs a
	hundred priority levels.

endmenu

menu "LTT tracepoints filtering"
	depends on RTAI_OPT_EXPERT

config RTAI_OPT_FILTER_EVIRQ
	bool "Disable IRQ-related tracepoints"
	default y if RTAI_OPT_FILTER_EVALL=y
	help
	
	When LTT support is active, this option disables tracepoints
	inside real-time interrupt handlers.

config RTAI_OPT_FILTER_EVTHR
	bool "Disable thread-related tracepoints"
	default y if RTAI_OPT_FILTER_EVALL=y
	help
	
	When LTT support is active, this option disables tracepoints
	inside most thread-related services.

config RTAI_OPT_FILTER_EVSYS
	bool "Disable syscall-related tracepoints"
	default y if RTAI_OPT_FILTER_EVALL=y
	help
	
	When LTT support is active, this option disables tracepoints
	inside the shadow syscall dispatcher.

config RTAI_OPT_FILTER_EVALL
	bool "Disable all tracepoints"
	default n
	help
	
	This option disables all LTT tracepoints inside RTAI/fusion.

endmenu

endmenu
```

## fusion/skins/Kconfig
```kconfig
menu "Skin support"

source "skins/rtai/Kconfig"

source "skins/posix/Kconfig"

source "skins/psos+/Kconfig"

source "skins/uitron/Kconfig"

source "skins/vrtx/Kconfig"

source "skins/vxworks/Kconfig"

config RTAI_OPT_VM
	bool "User-space VM support"
	default y
	help

	RTAI/vm technology allows applications based on legacy RTOS
	APIs to run inside virtual machines in user-space
	with hard real-time capabilities.
	If activated, this option will cause in-kernel emulators
	which have been selected in the current menu to be
	compiled as process-embeddable virtual machines too.

endmenu
```

## fusion/skins/compat/Kconfig
```kconfig
config RTAI_SKIN_COMPAT
	bool "RTAI/classic emulator"
	default n
	help

	An emulator of RTAI/classic's API.

config RTAI_OPT_COMPAT_FIFO
	bool "Fifos"
	depends on RTAI_OPT_PIPE && RTAI_SKIN_COMPAT
	default y
	help
	
	Fifos are uni-directional communication channels allowing data
	exchange between real-time tasks in kernel-space and regular
	user-space processes.

config RTAI_OPT_COMPAT_SEM
	bool "Semaphores"
	depends on RTAI_SKIN_COMPAT
	default y
	help
	
	Semaphores are synchronization objects granting RTAI
	tasks a concurrent access to a given number of resources.
```

## fusion/skins/posix/Kconfig
```kconfig
config RTAI_SKIN_POSIX
	bool "POSIX API"
	default y
	help

	A POSIX-compliant skin.
```

## fusion/skins/psos+/Kconfig
```kconfig
config RTAI_SKIN_PSOS
	bool "pSOS+ emulator"
	default y if RTAI_OPT_VM=y
	help

	This API skin emulates WindRiver's pSOS+ operating system.
```

## fusion/skins/rtai/Kconfig
```kconfig
config RTAI_SKIN_NATIVE
	bool "RTAI API"
	default y
	help

	The native RTAI API.

config RTAI_OPT_NATIVE_REGISTRY
	bool "Registry support"
	depends on RTAI_SKIN_NATIVE
	default y
	help
	
	The registry is used to bind real-time objects created by the
	RTAI skin to a symbolic name, so that they can be further
	retrieved and shared by real-time applications regardless of
	their runtime space (i.e. kernel or user). Each named object
	occupies a registry slot.

config RTAI_OPT_NATIVE_REGISTRY_NRSLOTS
	string "Number of registry slots"
	depends on RTAI_OPT_NATIVE_REGISTRY
	default 512
	help
	
	This option sets the maximum number of real-time objects the
	registry can handle.

config RTAI_OPT_NATIVE_PIPE
	bool "Message pipes"
	depends on RTAI_OPT_PIPE && RTAI_SKIN_NATIVE
	default y
	help
	
	Message pipes are bi-directional FIFO communication
	channels allowing data exchange between real-time tasks
	and regular user-space processes. Pipes natively preserve
	message boundaries, but can also be used in byte stream mode
	from kernel to user space.

	The maximum number of pipes available in the system can be
	configured using the RTAI_OPT_PIPE_NRDEV option from the
	Nucleus menu.

config RTAI_OPT_NATIVE_PIPE_BUFSZ
	string "Bytes in buffer space"
	depends on RTAI_OPT_NATIVE_PIPE
	default 4096
	help
	
	This option sets the memory size available for per-pipe
	buffering when message pipes are used in byte stream mode.

config RTAI_OPT_NATIVE_SEM
	bool "Counting semaphores"
	depends on RTAI_SKIN_NATIVE
	default y
	help
	
	Counting semaphore are synchronization objects granting RTAI
	tasks a concurrent access to a given number of resources
	maintained in an internal counter variable.

config RTAI_OPT_NATIVE_EVENT
	bool "Event flags"
	depends on RTAI_SKIN_NATIVE
	default y
	help
	
	Event flag groups are synchronization objects represented by a
	long-word structure; every available bit in such word can be used
	to map a user-defined event flag RTAI tasks can wait for.

config RTAI_OPT_NATIVE_MUTEX
	bool "Mutexes"
	depends on RTAI_SKIN_NATIVE
	default y if RTAI_OPT_NATIVE_COND=y
	help
	
	Mutexes are MUTual EXclusion objects, useful for protecting
	shared data structures from concurrent modifications, and
	implementing critical sections and monitors.

config RTAI_OPT_NATIVE_COND
	bool "Condition variables"
	depends on RTAI_SKIN_NATIVE
	enable RTAI_OPT_NATIVE_MUTEX
	help
	
	Condition variables are synchronization objects which
	allows RTAI tasks to suspend execution until some predicate on
	shared data is satisfied. 

config RTAI_OPT_NATIVE_QUEUE
	bool "Message queues"
	depends on RTAI_SKIN_NATIVE
	help
	
	Message queueing is a method by which real-time tasks can
	exchange or pass data through a RTAI-managed queue of
	messages. Messages can vary in length and be assigned
	different types or usages.

config RTAI_OPT_NATIVE_HEAP
	bool "Memory heaps"
	depends on RTAI_SKIN_NATIVE
	help

	Memory heaps are regions of memory used for dynamic memory
	allocation in a time-bounded fashion.

config RTAI_OPT_NATIVE_ALARM
	bool "Alarms"
	depends on RTAI_SKIN_NATIVE
	help
	
	Alarms are general watchdog timers allowing to run
	user-defined handlers after a specified delay has elapsed.
```

## fusion/skins/uitron/Kconfig
```kconfig
config RTAI_SKIN_UITRON
	bool "uITRON API"
	default n
	help

	This API skin emulates the uITRON API. 
```

## fusion/skins/vrtx/Kconfig
```kconfig
config RTAI_SKIN_VRTX
	bool "VRTX emulator"
	default y
	help

	This API skin emulates Mentor Graphics's VRTX operating
	system.
```

## fusion/skins/vxworks/Kconfig
```kconfig
config RTAI_SKIN_VXWORKS
	bool "VxWorks emulator"
	default y
	help

	This API skin emulates WindRiver's VxWorks operating system.
```
